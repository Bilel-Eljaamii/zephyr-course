## CMakeLists.txt
```
cmake_minimum_required(VERSION 3.20.0)

set(DTC_OVERLAY_FILE "${CMAKE_CURRENT_SOURCE_DIR}/boards/esp32c6_devkit.overlay")
find_package(Zephyr REQUIRED)
project(my_zephyr_app)

target_sources(app PRIVATE src/main.cpp)
```

## Kconfig
```
menuconfig LED_SUBSYSTEM
    bool "LED Subsystem"
    default y

if LED_SUBSYSTEM

choice 
    prompt "LED blink sleep time"
    default BLINK_SLEEP_1S

config BLINK_SLEEP_250MS
    bool "250ms (ultra fast)"

config BLINK_SLEEP_500MS
    bool "500ms (fast)"

config BLINK_SLEEP_1S
    bool "1s (medium)"

config BLINK_SLEEP_2S
    bool "2s (slow)"
endchoice

config BLINK_SLEEP_TIME_MS # This should be used in code
    int
    default 250 if BLINK_SLEEP_250MS
    default 500 if BLINK_SLEEP_500MS
    default 1000 if BLINK_SLEEP_1S
    default 2000 if BLINK_SLEEP_2S
    default 0

menuconfig ADVANCED_LED_SETTINGS
    bool "Advanced LED settings"
    default n

if ADVANCED_LED_SETTINGS

config LED_BRIGHTNESS
    int "LED brightness"
    default 100
    range 0 100
    help
      Brightness of the LED

config LED_FADE_DURATION
    int "LED fade duration"
    default 500
    range 0 5000
    help
      Duration of the brightness change of LED

endif

menu "Expert settings"
    visible if ADVANCED_LED_SETTINGS

config LED_DEBUG
    bool "Enable LED debugging"
    default n 

config CUSTOM_LED_PATTERN
    bool "Custom blink pattern"
    default n
endmenu
endif

source "Kconfig.zephyr"
```

## prj.conf
```kconfig
CONFIG_GPIO=y
CONFIG_LOG=y
CONFIG_WS2812_STRIP=y
CONFIG_WS2812_STRIP_RMT=y
CONFIG_LED_STRIP=y
CONFIG_WS2812_STRIP_RMT=y
CONFIG_ENTROPY_GENERATOR=y
```

## boards/esp32c6_devkit.overlay
```dts
/ {
    aliases {
        led0 = &my_led;
    };

    leds {
        compatible = "gpio-leds";
        my_led: led_0 {
            gpios = <&gpio0 2 GPIO_ACTIVE_HIGH>;
            label = "Onboard RGB LED";
        };
    };
};
```

## src/main.cpp
```c
#include <zephyr/kernel.h>
#include <zephyr/drivers/led_strip.h>
#include <zephyr/device.h>
#include <zephyr/random/random.h>
#include <zephyr/logging/log.h>

LOG_MODULE_REGISTER(main, LOG_LEVEL_INF);

#define SLEEP_TIME_MS 1000
#define STRIP_NODE    DT_ALIAS(led_strip)
#define STRIP_NUM_LEDS DT_PROP(STRIP_NODE, chain-length)

static const struct device *strip = DEVICE_DT_GET(STRIP_NODE);
static struct led_rgb pixels[STRIP_NUM_LEDS];

int main(void)
{
    if (!device_is_ready(strip)) {
        LOG_ERR("LED strip device not ready");
        return 0;
    }

    LOG_INF("Found LED strip with %d LEDs", STRIP_NUM_LEDS);

    while (1) {
        /* Generate a random color */
        uint32_t random_val = sys_rand32_get();
        uint8_t r = (uint8_t)(random_val >> 16);
        uint8_t g = (uint8_t)(random_val >> 8);
        uint8_t b = (uint8_t)(random_val);

        /* Apply the same random color to all LEDs in the strip */
        for (int i = 0; i < STRIP_NUM_LEDS; i++) {
            pixels[i].r = r;
            pixels[i].g = g;
            pixels[i].b = b;
        }

        /* Send data to the strip */
        if (led_strip_update_rgb(strip, pixels, STRIP_NUM_LEDS) < 0) {
            LOG_ERR("Failed to update LED strip");
        }

        LOG_INF("Color changed to R:%d G:%d B:%d", r, g, b);
        
        k_msleep(SLEEP_TIME_MS);
    }
    return 0;
}
```
